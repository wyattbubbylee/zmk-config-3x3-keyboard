## config/boards/shields/ninepad/Kconfig.defconfig
```kconfig
if SHIELD_NINEPAD

config ZMK_KEYBOARD_NAME
    default "Ninepad"

config USB_DEVICE_MANUFACTURER
    default "Waylon Walker"

config ZMK_MOUSE
    default y


endif
```
